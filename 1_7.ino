// I/O optimization, migration MH-Z19B PWM to UART
///////////////////////////////////////////////////////// внешні бібліотеки
#include <Arduino.h>                           // шоб меньше ошибок совместимости було
#include <U8g2lib.h>                           // драйвер дисплея
#include "DHT.h"                               // сенсор влажності і температури
#include <EncButton.h>                         // робота енкодера !!! мае баги в роботі !!!
#include <Wire.h>                              // І2С
#include <SPI.h>                               // спі на якому висить дісплей
#include "Max44009.h"                          // люксометр
#include <Adafruit_BMP280.h>                   // барометр
#include "MAX30105.h"                          // пульсометр
#include "heartRate.h"                         // чекер пульса
#include <iarduino_RTC.h>                      // часи
#include "MHZ19.h"

/////////////////////////////////////////////////////////////////// картінки
// https://duino.ru/media/image-converter/index.html

struct ClickPic {

// Для получения этого кода использовался онлайн конвертер https://duino.ru/media/image-converter/index.html 
const uint16_t logo_widht PROGMEM = 128; // Размер в пикселях, а не в байтах
const uint16_t logo_height PROGMEM = 128;
// const uint16_t logo_size PROGMEM = 2048;
const uint8_t logo[2048] PROGMEM = {
  0b00000000, 0b00000000, 0b00000000, 0b00000000, 0b00000000, 0b00000000, 0b00000000, 0b00000000, 0b00000000, 0b01111100, 0b00000000, 0b01000000, 0b00000000, 0b00000000, 0b00000000, 0b00000000,
  0b00000000, 0b00000000, 0b00000000, 0b00000000, 0b00000000, 0b00000000, 0b00000000, 0b00000000, 0b00000001, 0b11111111, 0b00000011, 0b11000000, 0b00000000, 0b00000000, 0b00000000, 0b00000000,
  0b00000000, 0b00000000, 0b00000000, 0b00000000, 0b00000000, 0b00000000, 0b00000000, 0b00000000, 0b00000011, 0b11111111, 0b10111010, 0b10110000, 0b00000000, 0b00000000, 0b00000000, 0b00000000,
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  0b00000000, 0b00000000, 0b00000000, 0b00010101, 0b01111111, 0b11111111, 0b11111111, 0b11111111, 0b11111111, 0b11111111, 0b11111111, 0b11111111, 0b10101010, 0b10101010, 0b10101111, 0b11111010,
};

  const uint16_t clickpic_widht PROGMEM = 64; // Размер в пикселях, а не в байтах
  const uint16_t clickpic_height PROGMEM = 64;
  const uint8_t clickpic[512] PROGMEM = {
    0b00000000, 0b00000001, 0b11000000, 0b00000000, 0b00000000, 0b00000000, 0b00000000, 0b00000000,
    0b00000000, 0b00000001, 0b11000000, 0b00000000, 0b00000000, 0b00000000, 0b00000000, 0b00000000,
    0b00000000, 0b00000001, 0b11000000, 0b00111000, 0b00000000, 0b00000000, 0b00000000, 0b00000000,
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    0b00000000, 0b00000000, 0b00000000, 0b00000000, 0b00111000, 0b00000000, 0b00000000, 0b00000000,
  };

  const uint16_t ser_widht PROGMEM = 45; // Размер в пикселях, а не в байтах
  const uint16_t ser_height PROGMEM = 45;
  const uint8_t ser[270] PROGMEM = {
    0b00000000, 0b00000000, 0b00000000, 0b00000000, 0b00000000, 0b00000000,
    0b00000000, 0b00000000, 0b00000000, 0b00000000, 0b00000000, 0b00000000,
    0b00000000, 0b00000000, 0b00000000, 0b00000000, 0b00000000, 0b00000000,
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    0b00000000, 0b00000000, 0b00000000, 0b00000000, 0b00000000, 0b00000000,
  };

};
ClickPic Pic;                                             // обявляем обект структури

/////////////////////////////////////////////////////// всякі класи
MHZ19 myMHZ19;                                             

HardwareSerial mySerial(2);

Adafruit_BMP280 bmp280;                                    // обєкт бібліотеки барометра

EncButton<EB_TICK,/*DT*/ 15, /*CLK*/ 32, /*SW*/ 34> enc;   // піни енкодера

U8G2_SSD1327_WS_128X128_F_4W_HW_SPI u8g2(U8G2_R0, /* cs=*/ 5, /* dc=*/ 2 ); // піни підключеня дисплея но тут вони не всі бо spi апаратний

DHT dht(4, DHT22);                                         // пін і тип сенсора влажності і температури 

Max44009 myLux(Max44009::Boolean::False);                  

MAX30105 PARTICLE_SENSOR;                                 // обявляе обект класа пусльсометра

iarduino_RTC watch(RTC_DS1307);                           // Объявляем объект watch для модуля на базе чипа DS1307

////////////////////////////////////////////////////// всякі переменні

struct Ir {
  byte ledBrightness  = 0;                         //  Задаём яркость работы светодиода, при этом потребление тока будет следующим: 0 - 0мА, 255 - 50 мА
  byte sampleAverage  = 8;                          //  Устанавливаем коэффициент усреднения. Возможные варианты значений: 1, 2, 4, 8, 16, 32
  byte ledMode        = 2;                          //  Устанавливаем режим работы светодиодов на сенсоре: 1 - только красный (Red only), 2 - красный и ИК (Red + IR), 3 - красный, ИК и зелёный (Red + IR + Green)
  byte sampleRate     = 200;                        //  Устанавливаем частоту дискретизации (сглаживания сигнала). Варианты: 50, 100, 200, 400, 800, 1000, 1600, 3200
  int  pulseWidth     = 411;                        //  Устанавливаем ширину импульса. Варианты: 69, 118, 215, 411
  int  adcRange       = 16384;                       //  Устанавливаем диапазон значений с АЦП. Варианты: 2048(11 бит), 4096(12 бит), 8192(13 бит), 16384(14 бит)

  byte rateSpot = 0;          //  Переменная с порядковым номером значения в массиве
  int beatAvg;                //  Создаём переменную для хранения усреднённого значения ЧСС
  long lastBeat = 0;          //  Время последнего зафиксированного удара
  float beatsPerMinute;       //  Создаём переменную для хранения значения ЧСС
  //const byte RATE_SIZE = 4;   //  Коэффициент усреднения. ЧЕм больше число, тем больше усреднение показаний.
  byte rates[4];      //  Массив со значениями ЧСС

  int irValue = 0;    // значенає динамічні
} ;
Ir IR;                // обект структури 


//int prevVal = LOW;              // !!!!!!!!!!!!!!!!!!!!!!!!!!!!!!!!!!!!!
//int th, tl, h, l, ppm;          // !!!!!!!!!!!!!!!!!!!!!!!!!!!!!!!!!!!!!
int ppm;
unsigned long getDataTimer = 0;

uint32_t lostTime = 0;

float flux = 0;

char wind = 0;

char16_t redtime = 0;

uint32_t trimi;

//uint32_t pressure_array[6];
//uint32_t sumX, sumY, sumX2, sumXY;
//float a, b;
//int delta;
//byte time_array[6];
int dispRain;

unsigned long startTime;
const unsigned long interval = 10 * 60 * 1000; // інтервал таймера (10 хвилин в мілісекундах)
byte preMas = 0;
const int MAS_SIZE = 6;
unsigned long preMasive [MAS_SIZE];
int MasIndex = 0;

String uap1[] = {
  "Пізда сухо","Сухо","Нормась","Заєбок","Шикарно","За дуже","%","C |","lux",
  "Давленіє","mm","СО 2", "ppm"
  };

String uap2[] = {
  "IR=","BPM=","SBPM=","Палець","Притули"
};

unsigned long pressure1, aver_pressure, pressure_array[6], time_array[6];
unsigned long sumX, sumY, sumX2, sumXY;
float a, b;
int delta;

///////////////////////////////////////////////////////////////////////// функції

void nextp () {                                // функція зміни сторінки
    if (enc.tick()) {                          // якшо з екнкодером були зміни
    
    if (enc.left() || enc.right()) {           // якшо поворот в ліво чи вправо
      if (wind == 0) {                         // якшо вибраний начальний монітор
        wind++;                                // то до номера сторінки +1
      } else {
        wind = wind -1;                        // якшо вибрана не стартова сторінка то вернути на таку
      }
    }
    if (enc.click()) wind = 3;                 // якшо кнопка нажата то відкрити меню 3 тоїсть часи

    enc.resetState();                          // скинути параметри енкодера. це наверно працює неправельно або під откос пускати цілу лібу і писати свою
  }
}

void redfix () {
  if (wind == 1 && redtime == 0) {             // фікс червоного светодіода пульсометра
    PARTICLE_SENSOR.setup(220, IR.sampleAverage, IR.ledMode, IR.sampleRate, IR.pulseWidth, IR.adcRange); // тут діод почті на макс (макс 255)
  } 
  if (wind == 0 && redtime > 0) {
    PARTICLE_SENSOR.setup(0, IR.sampleAverage, IR.ledMode, IR.sampleRate, IR.pulseWidth, IR.adcRange);   // логічно шо тут він виключаний
    redtime = 0;                    // і тут вспливає таймер повернення на головний дисплей
  }
}

int givFlux () {                             // функція збору люксів 
    if (millis() - lostTime >= 1000) {       // шоб дані не збиралися дуже часто
    lostTime += 1000;                        // тут скидуєм таймер
    flux = myLux.getLux();                   // і получаєм люксіки
  }
    return flux;                             // вертаєм в глобалочку
}

//int pipin () {
//  int myVal = digitalRead(35);
//  if (myVal == HIGH) {
//    if (myVal != prevVal) {
//      h = millis();
//      tl = h - l;
//      prevVal = myVal;
//    }
//  }  else {
//    if (myVal != prevVal) {
//      l = millis();
//      th = l - h;
//      prevVal = myVal;
//      ppm = 5000 * (th - 2) / (th + tl - 4);
//    }
//  }
//  return ppm;
//}

void backTimer(){
  if(millis() - trimi >= 3000 && IR.irValue < 50000){
    trimi = millis();
    wind = wind -1;
  }
}

void printCursor(int x,int y, const String& mas) {
  u8g2.setCursor(x,y);
  u8g2.print(mas);
}

void printCursor(int x,int y, int cola) {
  u8g2.setCursor(x,y);
  u8g2.print(cola);
}

void printCursor(int x,int y, float coca) {
  u8g2.setCursor(x,y);
  u8g2.print(coca);
}

float sbpm (float beatsPerMinute) {
  if (IR.beatsPerMinute < 255 && IR.beatsPerMinute > 20) {         //  Если количество ударов в минуту находится в промежутке между 20 и 255, то
        IR.rates[IR.rateSpot++] = (byte)IR.beatsPerMinute;         //  записываем это значение в массив значений ЧСС
        IR.rateSpot %= 4;                                          //  Задаём порядковый номер значения в массиве, возвращая остаток от деления и присваивая его переменной rateSpot
        IR.beatAvg = 0;                                            //  Обнуляем переменную и
        for (byte x = 0 ; x < 4 ; x++) {                           //  в цикле выполняем усреднение значений (чем больше RATE_SIZE, тем сильнее усреднение)
          IR.beatAvg += IR.rates[x];                               //  путём сложения всех элементов массива
        }
        IR.beatAvg /= 4;                                           //  а затем деления всей суммы на коэффициент усреднения (на общее количество элементов в массиве)
      }
  return IR.beatAvg;
}

int checkBeat (int irValue) {
  if (checkForBeat(IR.irValue) == true) {                     //  если пульс был зафиксирован, то
    long delta = millis() - IR.lastBeat;                   //  находим дельту по времени между ударами
    IR.lastBeat = millis();                                //  Обновляем счётчик
    IR.beatsPerMinute = 60 / (delta / 1000.0);             //  Вычисляем количество ударов в минуту
  }
  return IR.beatsPerMinute;
}

int redSens () {
  if (wind == 1) {

    redtime++;
    IR.irValue = PARTICLE_SENSOR.getIR();               //  Считываем значение отражённого ИК-светодиода (отвечающего за пульс) и

    checkBeat (IR.irValue);
    sbpm (IR.beatsPerMinute);
  }
  return IR.irValue;
}

long aver_sens() {
  pressure1 = 0;
  for (byte i = 0; i < 10; i++) {
    pressure1 += bmp280.readPressure();
  }
  aver_pressure = pressure1 / 10;
  return aver_pressure;
}

//////////////////////////////////////////////////////////////////////////// ламповий сетапчик
void setup(void) {

  Serial.begin(9600);

  mySerial.begin(9600);                               // (Uno example) device to MH-Z19 serial start
  myMHZ19.begin(mySerial);                                // *Serial(Stream) reference must be passed to library begin().
  myMHZ19.autoCalibration();                              // Turn auto calibration ON (OFF autoCalibration(false))

  dht.begin();
  
  u8g2.begin();
  u8g2.drawBitmap(0, 0, 16, 128, Pic.logo);
  u8g2.sendBuffer();
  delay(1000);
  
  u8g2.enableUTF8Print();  
  u8g2.setFont(u8g2_font_cu12_t_cyrillic);

  bmp280.begin(0x76); 

  Wire.begin(21, 22);

  myLux.configure(MAX44009_DEFAULT_ADDRESS, &Wire);

  pinMode(35, INPUT);    

  PARTICLE_SENSOR.begin();

  PARTICLE_SENSOR.setup(IR.ledBrightness, IR.sampleAverage, IR.ledMode, IR.sampleRate, IR.pulseWidth, IR.adcRange);

  watch.begin();

  startTime = millis(); // встановлення часу початку
}

////////////////////////////////////////////////////////////////////// основна куча гавна
void loop(void) {

  float pressure = bmp280.readPressure()*0.00750063755419211;

  aver_sens();
  //Serial.println(aver_sens());

  pressure1 = aver_sens();                          // найти текущее давление по среднему арифметическому
  for (byte i = 0; i < 5; i++) {                   // счётчик от 0 до 5 (да, до 5. Так как 4 меньше 5)
    pressure_array[i] = pressure_array[i + 1];     // сдвинуть массив давлений КРОМЕ ПОСЛЕДНЕЙ ЯЧЕЙКИ на шаг назад
  }
  pressure_array[5] = pressure1; 

  sumX = 0;
  sumY = 0;
  sumX2 = 0;
  sumXY = 0;
  for (int i = 0; i < 6; i++) {                    // для всех элементов массива
    sumX += time_array[i];
    sumY += (long)pressure_array[i];
    sumX2 += time_array[i] * time_array[i];
    sumXY += (long)time_array[i] * pressure_array[i];
    }
  a = 0;
  a = (long)6 * sumXY;             // расчёт коэффициента наклона приямой
  a = a - (long)sumX * sumY;
  a = (float)a / (6 * sumX2 - sumX * sumX);

  delta = a * 6;                   // расчёт изменения давления

  //Serial.println(delta);
  dispRain = map(delta, -250, 250, -100, 100);  // пересчитать в проценты
  Serial.println(String(pressure_array[5]) + " " + String(delta) + " " + String(dispRain));   // дебаг
  //Serial.println(pressure_array[1]);
  //Serial.println(pressure_array[2]);
  //Serial.println(pressure_array[3]);
  //Serial.println(pressure_array[4]);
  //Serial.println(pressure_array[5]);
  //if (millis() - startTime >= interval) { // таймер досягнув 10 хвилин, виконуємо потрібні дії
    
    //Serial.println("10 хвилин минуло!");
    //preMas++;

    //preMasive[MasIndex] = pressure;

    //MasIndex = (MasIndex + 1) % MAS_SIZE;

    //for (int i = MAS_SIZE - 1; i > 0; i--) {
    //preMasive[i] = preMasive[i - 1];

    //preMasive[0] = pressure;

    //Serial.print (preMasive[0]);
    //Serial.print (preMasive[1]);
    //Serial.print (preMasive[2]);
    //Serial.print (preMasive[3]);
    //Serial.print (preMasive[4]);
    //Serial.print (preMasive[5]);
    //Serial.print (preMasive[6]);
    //}

   // if (preMas == 5) {
   //   preMas = 0;
   // }
    
    //startTime = millis();// перезапуск таймера
  //}


  // тут делаем линейную аппроксимацию для предсказания погоды
  //  long averPress = 0;
  //  for (byte i = 0; i < 10; i++) {
  //    bmp280.takeForcedMeasurement();
  //    averPress += bmp280.readPressure();
  //    delay(1);
   // }
   // averPress /= 10;

   // for (byte i = 0; i < 5; i++) {                   // счётчик от 0 до 5 (да, до 5. Так как 4 меньше 5)
   //   pressure_array[i] = pressure_array[i + 1];     // сдвинуть массив давлений КРОМЕ ПОСЛЕДНЕЙ ЯЧЕЙКИ на шаг назад
    //}
    //pressure_array[5] = averPress;                    // последний элемент массива теперь - новое давление
    //sumX = 0;
    //sumY = 0;
    //sumX2 = 0;
    //sumXY = 0;
    //for (int i = 0; i < 6; i++) {                    // для всех элементов массива
    //  sumX += time_array[i];
     // sumY += (long)pressure_array[i];
     // sumX2 += time_array[i] * time_array[i];
     // sumXY += (long)time_array[i] * pressure_array[i];
   // }
    //a = 0;
    //a = (long)6 * sumXY;             // расчёт коэффициента наклона приямой
    //a = a - (long)sumX * sumY;
    //a = (float)a / (6 * sumX2 - sumX * sumX);
    //delta = a * 6;      // расчёт изменения давления
    //dispRain = map(delta, -250, 250, -100, 100);  // пересчитать в проценты
    //Serial.println(String(pressure_array[5]) + " " + String(delta) + " " + String(dispRain));   // дебаг


  //pipin();

  if (millis() - getDataTimer >= 2000) {

    ppm = myMHZ19.getCO2();                             // Request CO2 (as ppm)

    getDataTimer = millis();
    }

  givFlux();

  redfix();

  redSens();


  float weep = dht.readHumidity();
  float temp = dht.readTemperature();

  nextp();
  
//////////////////////////////////////////////////////////////////////////////   Графіка

  switch (wind) {

    case 0:                               /////////
      u8g2.firstPage();
      do {

        u8g2.setCursor(0, 12);
        if (weep < 30){
          u8g2.print(uap1[0]);
        } else if (weep < 40) {
          u8g2.print(uap1[1]);
        } else if (weep < 45) {
          u8g2.print(uap1[2]);
        } else if (weep < 50) {
          u8g2.print(uap1[3]);
        } else if (weep < 60) {
          u8g2.print(uap1[4]);
        } else {
          u8g2.print(uap1[5]);
        }
        printCursor (75,12,weep);
        printCursor (113,12,uap1[6]);


        printCursor (0,50,temp);
        printCursor (36,50,uap1[7]);


        printCursor (61,50,flux);
        if (flux < 1000) {
          if (flux < 10) {
            u8g2.setCursor(93, 50);
          } else  if (flux < 100) {
            u8g2.setCursor(100, 50);
          } else {
            u8g2.setCursor(105, 50);
          }
          u8g2.print(uap1[8]);
        }

        printCursor (0,90,uap1[9]);
        printCursor (60,90,pressure);
        printCursor (105,90,uap1[10]);

        printCursor (0,126,uap1[11]);
        printCursor (40,126,ppm);
        printCursor (75,124,uap1[12]);

        trimi = millis();

      } while ( u8g2.nextPage() );
      break;

    case 1:                                 //////////
      u8g2.firstPage();
      do {

        backTimer();

        if (IR.irValue > 50000) {

          printCursor (0,15,uap2[0]);
          printCursor (33,15,IR.irValue);


          printCursor (0,32,uap2[1]);
          printCursor (48,32,IR.beatsPerMinute);


          printCursor (0,47,uap2[2]);
          printCursor (55,47,IR.beatAvg);

          u8g2.drawBitmap(83, 5, 6, 45, Pic.ser);

          trimi = millis();
          
        } else {

          printCursor (0,32,uap2[3]);
          printCursor (0,50,uap2[4]);

          u8g2.drawBitmap(64, 0, 8, 64, Pic.clickpic);
          
        }
      } while ( u8g2.nextPage() );
    break;

    case 2:
    u8g2.firstPage();
    do{

      u8g2.setFont(u8g2_font_courB18_tn );
      printCursor (0,20,watch.gettime("d-m"));

      u8g2.setFont(u8g2_font_maniac_tn);
      printCursor (0,60,watch.gettime("H:i:s"));
      u8g2.setFont(u8g2_font_cu12_t_cyrillic);

    } while ( u8g2.nextPage() );

  }
}
// spo2
// баг фікс середьньго серцевого ритму
// нормальне зміненя дисплеїв
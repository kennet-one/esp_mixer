///////////////////////////////////////////////////////// внешні бібліотеки
#include <Arduino.h>                           // шоб меньше ошибок совместимости було
#include <U8g2lib.h>                           // драйвер дисплея
#include "DHT.h"                               // сенсор влажності і температури
#include <EncButton.h>                         // робота енкодера !!! мае баги в роботі !!!
#include <Wire.h>                              // І2С
#include <SPI.h>                               // спі на якому висить дісплей
#include "Max44009.h"                          // люксометр
#include <Adafruit_BMP280.h>                   // барометр
#include "MAX30105.h"
#include "heartRate.h"

/////////////////////////////////////////////////////////////////// картінки
// https://duino.ru/media/image-converter/index.html

const uint16_t image_widht PROGMEM = 64; // Размер в пикселях, а не в байтах
const uint16_t image_height PROGMEM = 64;
const uint8_t logo[512] PROGMEM = {
  0b00100101, 0b00100100, 0b10001010, 0b10000000, 0b00001110, 0b00001000, 0b00000000, 0b10100100,
  0b10010010, 0b01001001, 0b00100000, 0b00010000, 0b00011111, 0b01111100, 0b00100110, 0b00101010,
  0b01001001, 0b00100100, 0b00101001, 0b00000000, 0b00011111, 0b11101100, 0b00001000, 0b10010101,
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  0b01010001, 0b00000111, 0b11111011, 0b01101101, 0b01101010, 0b10011010, 0b11001010, 0b10111110,
};

//-------------------------------------------------// всякі класи

Adafruit_BMP280 bmp280;

EncButton<EB_TICK,/*DT*/ 15, /*CLK*/ 32, /*SW*/ 34> enc;

U8G2_SH1106_128X64_NONAME_F_4W_HW_SPI u8g2(U8G2_R0,/*!!!*/ 5, 16, 17);

DHT dht(4, DHT22);

Max44009 myLux(Max44009::Boolean::False);

MAX30105 PARTICLE_SENSOR;
//----------------------------------------------// всякі переменні

const byte RATE_SIZE = 4;   //  Коэффициент усреднения. ЧЕм больше число, тем больше усреднение показаний.
byte rates[RATE_SIZE];      //  Массив со значениями ЧСС
byte rateSpot = 0;          //  Переменная с порядковым номером значения в массиве
long lastBeat = 0;          //  Время последнего зафиксированного удара
float beatsPerMinute;       //  Создаём переменную для хранения значения ЧСС
int beatAvg;                //  Создаём переменную для хранения усреднённого значения ЧСС

int prevVal = LOW;
long th, tl, h, l, ppm;

uint32_t lostTime = 0;

float flux = 0;

char wind = 0;

//---------------------------------------------------------// ламповий сетапчик
void setup(void) {

  Serial.begin(9600);

  dht.begin();
  
  u8g2.begin();
  u8g2.clearBuffer();
  u8g2.drawBitmap(0, 0, 8, 64, logo);
  u8g2.sendBuffer();
  delay(1000);
  
  u8g2.enableUTF8Print();  
  u8g2.setFont(u8g2_font_cu12_t_cyrillic);

  bmp280.begin(0x76); 

  Wire.begin(21, 22);

  myLux.configure(MAX44009_DEFAULT_ADDRESS, &Wire);

  pinMode(35, INPUT);    

  PARTICLE_SENSOR.begin();
  //  Блок настроек сенсора для работы в режиме определения насыщенности крови кислородом и определения ЧСС:
  byte ledBrightness  = 220;                         //  Задаём яркость работы светодиода, при этом потребление тока будет следующим: 0 - 0мА, 255 - 50 мА
  byte sampleAverage  = 8;                          //  Устанавливаем коэффициент усреднения. Возможные варианты значений: 1, 2, 4, 8, 16, 32
  byte ledMode        = 2;                          //  Устанавливаем режим работы светодиодов на сенсоре: 1 - только красный (Red only), 2 - красный и ИК (Red + IR), 3 - красный, ИК и зелёный (Red + IR + Green)
  byte sampleRate     = 200;                        //  Устанавливаем частоту дискретизации (сглаживания сигнала). Варианты: 50, 100, 200, 400, 800, 1000, 1600, 3200
  int  pulseWidth     = 411;                        //  Устанавливаем ширину импульса. Варианты: 69, 118, 215, 411
  int  adcRange       = 16384;                       //  Устанавливаем диапазон значений с АЦП. Варианты: 2048(11 бит), 4096(12 бит), 8192(13 бит), 16384(14 бит)
  //------------------------------------------------//
  PARTICLE_SENSOR.setup(ledBrightness, sampleAverage, ledMode, sampleRate, pulseWidth, adcRange);
}
///////////////////////////////////////////////////////////////////////// функції
void nextp () {
    if (enc.tick()) {
    
    if (enc.left() || enc.right()) {
      if (wind == 0) {
        wind = wind +1;
      } else {
        wind = wind -1;
      }
    }
    if (enc.click()) Serial.println("click");

    enc.resetState();
  }
}

////////////////////////////////////////////////////////////////////// основна куча гавна
void loop(void) {

  long timer = millis();

  int myVal = digitalRead(35);
  if (myVal == HIGH) {
    if (myVal != prevVal) {
      h = timer;
      tl = h - l;
      prevVal = myVal;
    }
  }  else {
    if (myVal != prevVal) {
      l = timer;
      th = l - h;
      prevVal = myVal;
      ppm = 5000 * (th - 2) / (th + tl - 4);
    }
  }
  
  if (timer - lostTime >= 1000) {
    lostTime += 1000;

    flux = myLux.getLux();
  }

  long irValue = PARTICLE_SENSOR.getIR();               //  Считываем значение отражённого ИК-светодиода (отвечающего за пульс) и
  if (checkForBeat(irValue) == true) {                  //  если пульс был зафиксирован, то
    long delta = timer - lastBeat;                   //  находим дельту по времени между ударами
    lastBeat = timer;                                //  Обновляем счётчик
    beatsPerMinute = 60 / (delta / 1000.0);             //  Вычисляем количество ударов в минуту
    if (beatsPerMinute < 255 && beatsPerMinute > 20) {  //  Если количество ударов в минуту находится в промежутке между 20 и 255, то
      rates[rateSpot++] = (byte)beatsPerMinute;         //  записываем это значение в массив значений ЧСС
      rateSpot %= RATE_SIZE;                            //  Задаём порядковый номер значения в массиве, возвращая остаток от деления и присваивая его переменной rateSpot
      beatAvg = 0;                                      //  Обнуляем переменную и
      for (byte x = 0 ; x < RATE_SIZE ; x++) {          //  в цикле выполняем усреднение значений (чем больше RATE_SIZE, тем сильнее усреднение)
        beatAvg += rates[x];                            //  путём сложения всех элементов массива
      }
      beatAvg /= RATE_SIZE;                             //  а затем деления всей суммы на коэффициент усреднения (на общее количество элементов в массиве)
    }
  }


  float pressure = bmp280.readPressure();

  float weep = dht.readHumidity();
  float warmth = dht.readTemperature();

  nextp ();

//////////////////////////////////////////////////////////////////////////////   Графіка
  if (wind == 0){

    u8g2.firstPage();
    do {

      u8g2.setCursor(0, 12);
      if (weep < 30){
        u8g2.print("Пізда сухо");
      } else if (weep < 40) {
        u8g2.print("Сухо");
      } else if (weep < 45) {
        u8g2.print("Нормась");
      } else if (weep < 50) {
        u8g2.print("Заєбок");
      } else if (weep < 60) {
        u8g2.print("Шикарно");
      } else {
        u8g2.print("За дуже");
      }
      u8g2.setCursor(75, 12);
      u8g2.print(weep);
      u8g2.setCursor(115, 12);
      u8g2.print("%");

      u8g2.setCursor(0, 29);
      u8g2.print(warmth);
      u8g2.setCursor(36, 29);
      u8g2.print("C |");

      u8g2.setCursor(61, 29);
      u8g2.print(flux);
      if (flux < 1000) {
        if (flux < 10) {
          u8g2.setCursor(93, 29);
        } else  if (flux < 100) {
          u8g2.setCursor(100, 29);
        } else {
          u8g2.setCursor(105, 29);
        }
        u8g2.print("lux");
      }

      u8g2.setCursor(0, 45);
      u8g2.print("Давленіє");
      u8g2.setCursor(60, 45);
      u8g2.print(pressure*0.00750063755419211);
      u8g2.setCursor(105, 45);
      u8g2.print("mm");

      u8g2.setCursor(0,63);
      u8g2.print("СО 2");
      u8g2.setCursor(40,63);
      u8g2.print(ppm);
      u8g2.setCursor(75,61);
      u8g2.print("ppm");

    } while ( u8g2.nextPage() );

  } else {

    u8g2.firstPage();
    do {

  //if (irValue < 50000)  Serial.print(" No finger?");    //  Если значение ИК-светодиода меньше указанного, то выводим текст о том, что палец убран с датчика

      u8g2.setCursor(0,15);
      u8g2.print("IR=");
      u8g2.setCursor(33,15);
      u8g2.print(irValue);

      u8g2.setCursor(0,32);
      u8g2.print("BPM=");
      u8g2.setCursor(48,32);
      u8g2.print(beatsPerMinute);

      u8g2.setCursor(0,47);
      u8g2.print("Avg BPM=");
      u8g2.setCursor(81,47);
      u8g2.print(beatAvg);

    } while ( u8g2.nextPage() );
  }
}

//
///////////////////////////////////////////////////////// внешні бібліотеки
#include <Arduino.h>                           // шоб меньше ошибок совместимости було
#include <U8g2lib.h>                           // драйвер дисплея
#include "DHT.h"                               // сенсор влажності і температури
#include <EncButton.h>                         // робота енкодера !!! мае баги в роботі !!!
#include <Wire.h>                              // І2С
#include <SPI.h>                               // спі на якому висить дісплей
#include "Max44009.h"                          // люксометр
#include <Adafruit_BMP280.h>                   // барометр
#include "MAX30105.h"                          // пульсометр
#include "heartRate.h"                         // чекер пульса
#include <iarduino_RTC.h>                      // часи

/////////////////////////////////////////////////////////////////// картінки
// https://duino.ru/media/image-converter/index.html

const uint16_t logo_widht PROGMEM = 64; // Размер в пикселях, а не в байтах
const uint16_t logo_height PROGMEM = 64;
const uint8_t logo[512] PROGMEM = {
  0b00100101, 0b00100100, 0b10001010, 0b10000000, 0b00001110, 0b00001000, 0b00000000, 0b10100100,
  0b10010010, 0b01001001, 0b00100000, 0b00010000, 0b00011111, 0b01111100, 0b00100110, 0b00101010,
  0b01001001, 0b00100100, 0b00101001, 0b00000000, 0b00011111, 0b11101100, 0b00001000, 0b10010101,
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  0b01010001, 0b00000111, 0b11111011, 0b01101101, 0b01101010, 0b10011010, 0b11001010, 0b10111110,
};

const uint16_t clickpic_widht PROGMEM = 64; // Размер в пикселях, а не в байтах
const uint16_t clickpic_height PROGMEM = 64;
const uint8_t clickpic[512] PROGMEM = {
  0b00000000, 0b00000001, 0b11000000, 0b00000000, 0b00000000, 0b00000000, 0b00000000, 0b00000000,
  0b00000000, 0b00000001, 0b11000000, 0b00000000, 0b00000000, 0b00000000, 0b00000000, 0b00000000,
  0b00000000, 0b00000001, 0b11000000, 0b00111000, 0b00000000, 0b00000000, 0b00000000, 0b00000000,
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  0b00000000, 0b00000000, 0b00000000, 0b00000000, 0b00111000, 0b00000000, 0b00000000, 0b00000000,
};

const uint16_t ser_widht PROGMEM = 45; // Размер в пикселях, а не в байтах
const uint16_t ser_height PROGMEM = 45;
const uint8_t ser[270] PROGMEM = {
  0b00000000, 0b00000000, 0b00000000, 0b00000000, 0b00000000, 0b00000000,
  0b00000000, 0b00000000, 0b00000000, 0b00000000, 0b00000000, 0b00000000,
  0b00000000, 0b00000000, 0b00000000, 0b00000000, 0b00000000, 0b00000000,
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  0b00000000, 0b00000000, 0b00000000, 0b00000000, 0b00000000, 0b00000000,
};

/////////////////////////////////////////////////////// всякі класи

Adafruit_BMP280 bmp280;                                    // обєкт бібліотеки барометра

EncButton<EB_TICK,/*DT*/ 15, /*CLK*/ 32, /*SW*/ 34> enc;   // піни енкодера

U8G2_SH1106_128X64_NONAME_F_4W_HW_SPI u8g2(U8G2_R0,/*!!!*/ 5, 16, 17);

DHT dht(4, DHT22);                                         // пін і тип сенсора влажності і температури 

Max44009 myLux(Max44009::Boolean::False);

MAX30105 PARTICLE_SENSOR;

iarduino_RTC watch(RTC_DS1307);                           // Объявляем объект watch для модуля на базе чипа DS1307

////////////////////////////////////////////////////// всякі переменні

struct Ir {
  byte ledBrightness  = 0;                         //  Задаём яркость работы светодиода, при этом потребление тока будет следующим: 0 - 0мА, 255 - 50 мА
  byte sampleAverage  = 8;                          //  Устанавливаем коэффициент усреднения. Возможные варианты значений: 1, 2, 4, 8, 16, 32
  byte ledMode        = 2;                          //  Устанавливаем режим работы светодиодов на сенсоре: 1 - только красный (Red only), 2 - красный и ИК (Red + IR), 3 - красный, ИК и зелёный (Red + IR + Green)
  byte sampleRate     = 200;                        //  Устанавливаем частоту дискретизации (сглаживания сигнала). Варианты: 50, 100, 200, 400, 800, 1000, 1600, 3200
  int  pulseWidth     = 411;                        //  Устанавливаем ширину импульса. Варианты: 69, 118, 215, 411
  int  adcRange       = 16384;                       //  Устанавливаем диапазон значений с АЦП. Варианты: 2048(11 бит), 4096(12 бит), 8192(13 бит), 16384(14 бит)

  byte rateSpot = 0;          //  Переменная с порядковым номером значения в массиве
  int beatAvg;                //  Создаём переменную для хранения усреднённого значения ЧСС
  long lastBeat = 0;          //  Время последнего зафиксированного удара
  float beatsPerMinute;       //  Создаём переменную для хранения значения ЧСС
  
} ;

Ir IR;

const byte RATE_SIZE = 4;   //  Коэффициент усреднения. ЧЕм больше число, тем больше усреднение показаний.
byte rates[RATE_SIZE];      //  Массив со значениями ЧСС

int prevVal = LOW;
int th, tl, h, l, ppm;

uint32_t lostTime = 0;

float flux = 0;

char wind = 0;

int irValue = 0;

char16_t redtime = 0;

uint32_t trimi;

String uap1[] = {
  "Пізда сухо","Сухо","Нормась","Заєбок","Шикарно","За дуже","%","C |","lux",
  "Давленіє","mm","СО 2", "ppm"
  };

String uap2[] = {
  "IR=","BPM=","SBPM=","Палець","Притули"
};

//String tictac;
///////////////////////////////////////////////////////////////////////// функції
void nextp () {
    if (enc.tick()) {
    
    if (enc.left() || enc.right()) {
      if (wind == 0) {
        wind++;
      } else {
        wind = wind -1;
      }
    }
    if (enc.click()) wind = 3;

    enc.resetState();
  }
}

void redfix () {
  if (wind == 1 && redtime == 0) {
    PARTICLE_SENSOR.setup(220, IR.sampleAverage, IR.ledMode, IR.sampleRate, IR.pulseWidth, IR.adcRange);
  } 
  if (wind == 0 && redtime > 0) {
    PARTICLE_SENSOR.setup(0, IR.sampleAverage, IR.ledMode, IR.sampleRate, IR.pulseWidth, IR.adcRange);
    redtime = 0;
  }
}

int givFlux () {
    if (millis() - lostTime >= 1000) {
    lostTime += 1000;
    flux = myLux.getLux();
  }
    return flux;
}

int pipin () {
  int myVal = digitalRead(35);
  if (myVal == HIGH) {
    if (myVal != prevVal) {
      h = millis();
      tl = h - l;
      prevVal = myVal;
    }
  }  else {
    if (myVal != prevVal) {
      l = millis();
      th = l - h;
      prevVal = myVal;
      ppm = 5000 * (th - 2) / (th + tl - 4);
    }
  }
  return ppm;
}

void backTimer(){
  if(millis() - trimi >= 3000 && irValue < 50000){
    trimi = millis();
    wind = wind -1;
  }
}

void printCursor(int x,int y, const String& mas) {
  u8g2.setCursor(x,y);
  u8g2.print(mas);
}

void printCursor(int x,int y, int cola) {
  u8g2.setCursor(x,y);
  u8g2.print(cola);
}

void printCursor(int x,int y, float coca) {
  u8g2.setCursor(x,y);
  u8g2.print(coca);
}

float sbpm (float beatsPerMinute) {
  if (IR.beatsPerMinute < 255 && IR.beatsPerMinute > 20) {  //  Если количество ударов в минуту находится в промежутке между 20 и 255, то
        rates[IR.rateSpot++] = (byte)IR.beatsPerMinute;         //  записываем это значение в массив значений ЧСС
        IR.rateSpot %= RATE_SIZE;                            //  Задаём порядковый номер значения в массиве, возвращая остаток от деления и присваивая его переменной rateSpot
        IR.beatAvg = 0;                                      //  Обнуляем переменную и
        for (byte x = 0 ; x < RATE_SIZE ; x++) {          //  в цикле выполняем усреднение значений (чем больше RATE_SIZE, тем сильнее усреднение)
          IR.beatAvg += rates[x];                            //  путём сложения всех элементов массива
        }
        IR.beatAvg /= RATE_SIZE;                             //  а затем деления всей суммы на коэффициент усреднения (на общее количество элементов в массиве)
      }
  return IR.beatAvg;
}

int checkBeat (int irValue) {
  if (checkForBeat(irValue) == true) {                  //  если пульс был зафиксирован, то
    long delta = millis() - IR.lastBeat;                   //  находим дельту по времени между ударами
    IR.lastBeat = millis();                                //  Обновляем счётчик
    IR.beatsPerMinute = 60 / (delta / 1000.0);             //  Вычисляем количество ударов в минуту
  }
  return IR.beatsPerMinute;
}

int redSens () {
  if (wind == 1) {

    redtime++;
    irValue = PARTICLE_SENSOR.getIR();               //  Считываем значение отражённого ИК-светодиода (отвечающего за пульс) и

    checkBeat (irValue);
    sbpm (IR.beatsPerMinute);
  }
  return irValue;
}
//////////////////////////////////////////////////////////////////////////// ламповий сетапчик
void setup(void) {

  Serial.begin(9600);

  dht.begin();
  
  u8g2.begin();
  u8g2.drawBitmap(0, 0, 8, 64, logo);
  u8g2.sendBuffer();
  delay(1000);
  
  u8g2.enableUTF8Print();  
  u8g2.setFont(u8g2_font_cu12_t_cyrillic);

  bmp280.begin(0x76); 

  Wire.begin(21, 22);

  myLux.configure(MAX44009_DEFAULT_ADDRESS, &Wire);

  pinMode(35, INPUT);    

  PARTICLE_SENSOR.begin();

  PARTICLE_SENSOR.setup(IR.ledBrightness, IR.sampleAverage, IR.ledMode, IR.sampleRate, IR.pulseWidth, IR.adcRange);

  watch.begin();
}

////////////////////////////////////////////////////////////////////// основна куча гавна
void loop(void) {


  pipin();

  givFlux();

  redfix();

  redSens();

  float pressure = bmp280.readPressure()*0.00750063755419211;

  float weep = dht.readHumidity();
  float temp = dht.readTemperature();

  nextp();
  
//////////////////////////////////////////////////////////////////////////////   Графіка

  switch (wind) {

    case 0:                               /////////
      u8g2.firstPage();
      do {

        u8g2.setCursor(0, 12);
        if (weep < 30){
          u8g2.print(uap1[0]);
        } else if (weep < 40) {
          u8g2.print(uap1[1]);
        } else if (weep < 45) {
          u8g2.print(uap1[2]);
        } else if (weep < 50) {
          u8g2.print(uap1[3]);
        } else if (weep < 60) {
          u8g2.print(uap1[4]);
        } else {
          u8g2.print(uap1[5]);
        }
        printCursor (75,12,weep);
        printCursor (113,12,uap1[6]);


        printCursor (0,29,temp);
        printCursor (36,29,uap1[7]);


        printCursor (61,29,flux);
        if (flux < 1000) {
          if (flux < 10) {
            u8g2.setCursor(93, 29);
          } else  if (flux < 100) {
            u8g2.setCursor(100, 29);
          } else {
            u8g2.setCursor(105, 29);
          }
          u8g2.print(uap1[8]);
        }

        printCursor (0,45,uap1[9]);
        printCursor (60,45,pressure);
        printCursor (105,45,uap1[10]);

        printCursor (0,63,uap1[11]);
        printCursor (40,63,ppm);
        printCursor (75,61,uap1[12]);

        trimi = millis();

      } while ( u8g2.nextPage() );
      break;

    case 1:                                 //////////
      u8g2.firstPage();
      do {

        backTimer();

        if (irValue > 50000) {

          printCursor (0,15,uap2[0]);
          printCursor (33,15,irValue);


          printCursor (0,32,uap2[1]);
          printCursor (48,32,IR.beatsPerMinute);


          printCursor (0,47,uap2[2]);
          printCursor (55,47,IR.beatAvg);

          u8g2.drawBitmap(83, 5, 6, 45, ser);

          trimi = millis();
          
        } else {

          printCursor (0,32,uap2[3]);
          printCursor (0,50,uap2[4]);

          u8g2.drawBitmap(64, 0, 8, 64, clickpic);
          
        }
      } while ( u8g2.nextPage() );
    break;

    case 2:
    u8g2.firstPage();
    do{

      u8g2.setFont(u8g2_font_courB18_tn );
      printCursor (0,20,watch.gettime("d-m"));

      u8g2.setFont(u8g2_font_maniac_tn);
      printCursor (0,60,watch.gettime("H:i:s"));
      u8g2.setFont(u8g2_font_cu12_t_cyrillic);

    } while ( u8g2.nextPage() );


  }
}
// auto ?
// spo2
// структури